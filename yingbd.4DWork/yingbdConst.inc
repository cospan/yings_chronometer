// File generated 10/18/2014 9:18:36 PM
// Warning! This is a generated file, any manual changes will be
// lost during the next generation.

#constant  Strings1Count    1
#constant  Strings1Size     7
#constant  Strings2Count    1
#constant  Strings2Size     9
#constant  Strings3Count    1
#constant  Strings3Size     3
#constant  Strings4Count    1
#constant  Strings4Size     5
#constant  Strings0Count    1
#constant  Strings0Size     19
#constant  Strings5Count    1
#constant  Strings5Size     20
#constant  Strings6Count    1
#constant  Strings6Size     9
#constant  Strings7Count    1
#constant  Strings7Size     6
#constant  Strings8Count    1
#constant  Strings8Size     2
#constant  Strings9Count    1
#constant  Strings9Size     2
#constant  Strings10Count    1
#constant  Strings10Size     10
#constant  Strings11Count    1
#constant  Strings11Size     2
#constant  Strings12Count    1
#constant  Strings12Size     18
#constant  Strings13Count    1
#constant  Strings13Size     2
// object indexes into ImageControl
#CONST
    iThermometer0   // offset 0x0
    iLeddigits0     // offset 0x15F400
    iiLeddigits0    // offset 0x160800
    iLeddigits1     // offset 0x165E00
    iiLeddigits1    // offset 0x167200
    iUserbutton3    // offset 0x16C800
    iStatictext1    // offset 0x16D200
    iStatictext2    // offset 0x16DE00
    iSlider0        // offset 0x16E800
    iStatictext8    // offset 0x22AE00
    iStatictext9    // offset 0x22B200
    iUserbutton7    // offset 0x22C200
    iUserbutton8    // offset 0x22D400
    iAngularmeter0  // offset 0x22E600
    iAngularmeter1  // offset 0x36A200
    iStatictext5    // offset 0x575000
    iUserbutton0    // offset 0x575E00
    iUserbutton1    // offset 0x576800
    iUserbutton2    // offset 0x577200
    iStatictext10   // offset 0x577C00
    iStatictext0    // offset 0x57CC00
    iUserbutton4    // offset 0x588400
    iVideo0         // offset 0x588E00
    iStatictext3    // offset 0x5E9E00
    iStatictext4    // offset 0x5EB400
#END

#constant  Strings1StartH   0x0
#constant  Strings1StartL   0x0
#constant  Strings2StartH   0x0
#constant  Strings2StartL   0x200
#constant  Strings3StartH   0x0
#constant  Strings3StartL   0x400
#constant  Strings4StartH   0x0
#constant  Strings4StartL   0x600
#constant  Strings0StartH   0x0
#constant  Strings0StartL   0x800
#constant  Strings5StartH   0x0
#constant  Strings5StartL   0xA00
#constant  Strings6StartH   0x0
#constant  Strings6StartL   0xC00
#constant  Strings7StartH   0x0
#constant  Strings7StartL   0xE00
#constant  Strings8StartH   0x0
#constant  Strings8StartL   0x1000
#constant  Strings9StartH   0x0
#constant  Strings9StartL   0x1200
#constant  Strings10StartH   0x0
#constant  Strings10StartL   0x1400
#constant  Strings11StartH   0x0
#constant  Strings11StartL   0x1600
#constant  Strings12StartH   0x0
#constant  Strings12StartL   0x1800
#constant  Strings13StartH   0x0
#constant  Strings13StartL   0x1A00
#IFNOT EXISTS NOGLOBALS
var disk, hndl ;
#ENDIF
